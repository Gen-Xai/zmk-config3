## boards/shields/syosei/Kconfig.defconfig
```kconfig
if SHIELD_SYOSEI_LEFT

config ZMK_KEYBOARD_NAME
    default "Syosei-L"

endif

if SHIELD_SYOSEI_RIGHT

config ZMK_KEYBOARD_NAME
    default "Syosei-R"

endif
```

## boards/shields/syosei/Kconfig.shield
```kconfig
config SHIELD_SYOSEI_LEFT
    def_bool y
    depends on SHIELD_IS_SYOSEI_LEFT

config SHIELD_SYOSEI_RIGHT
    def_bool y
    depends on SHIELD_IS_SYOSEI_RIGHT
```
